#define VERSION_MACRO
macro_ver: macro_ver {
compatible = "zmk,behavior-macro";
#binding-cells = <0>;
bindings = <&kp N2>, <&kp N0>, <&kp N2>, <&kp N6>, <&kp N0>, <&kp N2>, <&kp N0>, <&kp N4>, <&kp MINUS>, <&kp V>, <&kp N3>, <&kp DOT>, <&kp N5>, <&kp MINUS>, <&kp F>, <&kp N8>, <&kp N2>, <&kp A>, <&kp N0>, <&kp N2>, <&kp E>, <&kp MINUS>, <&kp C>, <&kp L>, <&kp I>, <&kp Q>, <&kp U>, <&kp E>, <&kp RET>;
};
